## conf/layer.conf
```bitbake
# SPDX-License-Identifier: MIT

# We have a conf and classes directory, add to BBPATH
BBPATH .= ":${LAYERDIR}"

# We have recipes-* directories, add to BBFILES
BBFILES += "${LAYERDIR}/recipes-*/*/*.bb \
            ${LAYERDIR}/recipes-*/*/*.bbappend"

BBFILE_COLLECTIONS += "meta-mion-sde"
BBFILE_PATTERN_meta-mion-sde = "^${LAYERDIR}/"
BBFILE_PRIORITY_meta-mion-sde = "6"

LAYERDEPENDS_meta-mion-sde = "core"
LAYERSERIES_COMPAT_meta-mion-sde  = "dunfell"
```

## meta-mion-barefoot/conf/layer.conf
```bitbake
# SPDX-License-Identifier: MIT

# We have a conf and classes directory, add to BBPATH
BBPATH .= ":${LAYERDIR}"

# We have recipes-* directories, add to BBFILES
BBFILES += "${LAYERDIR}/recipes-*/*/*.bb \
            ${LAYERDIR}/recipes-*/*/*.bbappend"

BBFILE_COLLECTIONS += "meta-mion-barefoot"
BBFILE_PATTERN_meta-mion-barefoot = "^${LAYERDIR}/"
BBFILE_PRIORITY_meta-mion-barefoot = "6"

LAYERDEPENDS_meta-mion-barefoot = "core"
LAYERSERIES_COMPAT_meta-mion-barefoot = "dunfell"
SDE_INSTALL = "/opt"
```
